/dts-v1/;
#include "cv184x_base_arm.dtsi"
#include "cv184x_asic_bga.dtsi"
#include "cv184x_asic_emmc.dtsi"
#include "cv184x_default_memmap.dtsi"

/ {
};

&wifi_pin {
	poweron-gpio = <&porta 15 GPIO_ACTIVE_HIGH>;
	wakeup-gpio = <&porte 10 GPIO_ACTIVE_HIGH>;
};

&wifisd {
	cap-sd-highspeed;
	sd-uhs-sdr104;
	status = "okay";
};

&uart2 {
	status = "okay";
};

&usb {
	vbus-en-gpio = <&portb 5 GPIO_ACTIVE_HIGH>;
	host-en-gpio = <&porta 30 GPIO_ACTIVE_HIGH>;
};
